; =============================================================================
;  thread_pick.cmm - vendor\2210_trace32\select_thread.cmm 的无界面对照版
;
;  客户的线程选择脚本遍历 g_osThreadList，把名字列在 DYNPULLDOWN 对话框里，
;  然后 STOP 等用户点击。本文件用同样的偏移量、同样的名字匹配做同一次遍历，
;  但有几点不同：
;     - 想要的名字由命令行参数传入（即第二个入口参数），
;     - 可选名字直接打印出来，而不是放进下拉框，
;     - 没有 DIALOG.* 也没有 STOP，所以能在 SCREEN=OFF 下运行。
;
;  下面的遍历逻辑逐字抄自客户脚本：
;     &thread_offset = Var.Value(&((osThread_t)0x0)->resource_node)
;     &thread_next   = Var.Value((void*)((osThread_t)&th)->resource_node.next)
;     &th            = &thread_next - &thread_offset
;
;  用法：   do thread_pick.cmm idle
;           ENTRY &picked          ; osThread_t 地址；没有匹配到时为 0
;
;  注意 - 本 PRACTICE 版本的实测怪癖：`do script.cmm "&want"` 会把引号一起传进来
;  （即 "idle"），因此与线程名做相等比较永远不匹配；
;  而 `do script.cmm &want` 传进来的才是 idle。所以调用方传宏时不能加引号。
;  （文件路径之所以能忍受带引号的形式，只是因为 TRACE32 打开文件时会剥掉引号 -
;  字符串比较不会。）
;  按这条规则，名字里含空格的线程仍会被拆开。
; =============================================================================
ON ERROR CONTinue

ENTRY &want
LOCAL &head &next &off &th &name &list &i &hit

&hit=0
&i=0
&list=""

IF !sYmbol.EXIST(g_osThreadList)
(
    PRINT "THREADPICK: no symbol g_osThreadList"
    ENDDO 0
)

&head=Var.Value((void*)&g_osThreadList)
&next=Var.Value((void*)g_osThreadList.next)
&off=Var.Value(&((osThread_t)0x0)->resource_node)

WHILE &head!=&next
(
    &th=&next-&off
    &name=Var.String(((osThread_t)&th)->name)
    PRINT "THREADPICK: [&i] &name"
    IF ("&list"=="")
        &list="&name"
    ELSE
        &list="&list,&name"
    IF ("&name"=="&want")
        &hit=&th
    &next=Var.Value((void*)((osThread_t)&th)->resource_node.next)
    &i=&i+1
)

PRINT "THREADPICK: available=&list"
IF &hit==0
    PRINT "THREADPICK: no thread named &want"

ENDDO &hit
