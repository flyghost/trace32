ON ERROR CONTinue
APPEND out\logs\gui.log "G1-START"
ON ERROR CONTinue
AREA.Create REPORT
AREA.view REPORT
APPEND out\logs\gui.log "G2-AFTER-AREAVIEW"
DIALOG.OK "headless dialog test"
APPEND out\logs\gui.log "G3-AFTER-DIALOGOK"
ON ERROR
APPEND out\logs\gui.log "G4-END"
QUIT
