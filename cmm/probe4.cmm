ON ERROR CONTinue
APPEND logs\probe4.log "P4-START"
ON ERROR CONTinue
SYStem.CPU STM32F407ZG
APPEND logs\probe4.log "P4-CPU-OK"
SYStem.Up
APPEND logs\probe4.log "P4-UP-OK"
ON ERROR
APPEND logs\probe4.log "P4-END"
QUIT
