; probe2.cmm - 不用 AREA，改用 APPEND（字面量路径）写证据
APPEND out\logs\probe2.log "P1-START"
APPEND out\logs\probe2.log "P2-BEFORE-CPU"
ON ERROR CONTinue
SYStem.CPU STM32F407ZG
APPEND out\logs\probe2.log "P3-AFTER-CPU"
SYStem.Up
APPEND out\logs\probe2.log "P4-AFTER-UP"
ON ERROR
APPEND out\logs\probe2.log "P5-END"
QUIT
