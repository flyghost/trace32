; probe1.cmm - 无界面离线启动测试（PBI=SIM, SCREEN=OFF）
; 证据写入报告文件，这样即使中途出错结果也能留下来
AREA.Create REPORT
AREA.CLEAR  REPORT
AREA.OPEN   REPORT "out\logs\probe1.txt"
PRINT "P1-START"
ON ERROR CONTinue
SYStem.CPU STM32F407ZG
PRINT "P2-CPU-SET-OK"
SYStem.Up
PRINT "P3-MODE-"+FORMAT.Decimal(2.,SYStem.Mode())
ON ERROR
PRINT "P4-LASTERR-"+ERROR.MESSAGE()
PRINT "P5-END"
AREA.CLOSE REPORT
QUIT
